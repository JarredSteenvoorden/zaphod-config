## boards/arm/zaphod/zaphod_defconfig
```kconfig
# SPDX-License-Identifier: MIT

CONFIG_SOC_SERIES_NRF52X=y
CONFIG_SOC_NRF52840_QIAA=y
CONFIG_BOARD_ZAPHOD=y

# Enable MPU
CONFIG_ARM_MPU=y

# enable GPIO
CONFIG_GPIO=y

CONFIG_ZMK_SLEEP=y

CONFIG_ZMK_DISPLAY=y
CONFIG_LVGL_USE_THEME_MONO=y
CONFIG_LVGL_COLOR_TRANSP_CUSTOM=y
CONFIG_LVGL_CUSTOM_COLOR_TRANSP_RED=0x00
CONFIG_LVGL_CUSTOM_COLOR_TRANSP_GREEN=0x00
CONFIG_LVGL_CUSTOM_COLOR_TRANSP_BLUE=0x00

CONFIG_USE_DT_CODE_PARTITION=y
CONFIG_BUILD_OUTPUT_UF2=y

CONFIG_MPU_ALLOW_FLASH_WRITE=y
CONFIG_NVS=y
CONFIG_SETTINGS_NVS=y
CONFIG_FLASH=y
CONFIG_FLASH_PAGE_LAYOUT=y
CONFIG_FLASH_MAP=y

# the number of combos that can be active at the same time. Default 4.
CONFIG_ZMK_COMBO_MAX_PRESSED_COMBOS=5

# the maximum number of combos that can be active on a key position. Defaults to 5.
# (So you can have 5 separate combos that use position 3 for example)
CONFIG_ZMK_COMBO_MAX_COMBOS_PER_KEY=60

# the maximum number of keys that need to be pressed to activate a combo. Default 4. 
# If you want a combo that triggers when pressing 5 keys, you'd set this to 5 for example.
CONFIG_ZMK_COMBO_MAX_KEYS_PER_COMBO=9

#CONFIG_ZMK_DISPLAY=n
#CONFIG_ZMK_USB_LOGGING=y
```
